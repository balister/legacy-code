## OE/ossie_collection/conf/distro/include/sane-ossie-revs.inc
```bitbake
SRCREV_pn-ossie-channeldemo ?= "6161"
SRCREV_pn-ossie-interpolator ?= "4557"
SRCREV_pn-ossie-modulator ?= "4512"
SRCREV_pn-ossie-randombits ?= "4503"
SRCREV_pn-ossie-rxdemo ?= "6162"
SRCREV_pn-ossie-txdemo ?= "6160"
SRCREV_pn-ossie-usrp-tx-control ?= "4076"
SRCREV_pn-ossie-cf ?= "380"
SRCREV_pn-ossie-sigproc ?= "251"
SRCREV_pn-ossie-standardinterfaces ?= "287"
SRCREV_pn-ossie-gpp-node ?= "375"
SRCREV_pn-ossie-gpp-sound-node ?= "158"
SRCREV_pn-ossie-c-wavloader ?= "179"
SRCREV_pn-ossie-gpp-device ?= "375"
SRCREV_pn-ossie-nodebooter ?= "376"
SRCREV_pn-ossie-soundout-device ?= "273"
SRCREV_pn-ossie-usrp-device ?= "255"
SRCREV_pn-ossie-demo ?= "5515"
SRCREV_pn-ossie-tx-random-data ?= "4502"
SRCREV_pn-ossie-fm-demod ?= "189"
SRCREV_pn-ossie-resampler ?= "190"
SRCREV_pn-ossie-fm-from-file ?= "279"
SRCREV_pn-ossie-file-input ?= "274"
SRCREV_pn-ossie-file2sound ?= "6460"
```
